## meta-jetson-customnux-bsp/conf/layer.conf
```bitbake
BBPATH  =. "${LAYERDIR}:"
BBFILES += " \
    ${LAYERDIR}/recipes*/*/*.bb \
    ${LAYERDIR}/recipes*/*/*.bbappend \
"

BBFILE_COLLECTIONS += "jetson-customnux-bsp"
BBFILE_PATTERN_jetson-customnux-bsp = "^${LAYERDIR}/"
BBFILE_PRIORITY_jetson-customnux-bsp = "13"
LAYERSERIES_COMPAT_jetson-customnux-bsp = "scarthgap"
```

## meta-jetson-customnux-bsp/conf/machine/custom-jetson-orin-nano-devkit-nvme.conf
```bitbake
require conf/machine/jetson-orin-nano-devkit-nvme.conf

UBOOT_EXTLINUX_KERNEL_ARGS="mminit_loglevel=4 console=ttyTCU0,115200 console=ttyAMA0,115200n8 kgdboc=ttyAMA0,115200 firmware_class.path=/etc/firmware fbcon=map:0 nospectre_bhb video=efifb:off console=tty0"

TEGRA_PLUGIN_MANAGER_OVERLAYS += " \
    tegra234-p3767-0000+p3509-a02-hdr40.dtbo \
    tegra234-p3767-test.dtbo \
    tegra234-p3767-camera-p3768-imx708.dtbo \
    tegra234-p3767-ultrasonic-p3768-hcsr04.dtbo \
    tegra234-p3767-light-p3768-bh1750.dtbo \
    tegra234-p3767-eeprom-p3768-at24c256.dtbo \
"
```

## meta-jetson-customnux-dashboard-dev/conf/layer.conf
```bitbake
BBPATH  =. "${LAYERDIR}:"
BBFILES += " \
    ${LAYERDIR}/recipes*/*/*.bb \
    ${LAYERDIR}/recipes*/*/*.bbappend \
"

BBFILE_COLLECTIONS += "jetson-customnux-dashboard-dev"
BBFILE_PATTERN_jetson-customnux-dashboard-dev = "^${LAYERDIR}/"
BBFILE_PRIORITY_jetson-customnux-dashboard-dev = "13"
LAYERSERIES_COMPAT_jetson-customnux-dashboard-dev = "scarthgap"
```

## meta-jetson-customnux-dashboard/conf/layer.conf
```bitbake
BBPATH  =. "${LAYERDIR}:"
BBFILES += " \
    ${LAYERDIR}/recipes*/*/*.bb \
    ${LAYERDIR}/recipes*/*/*.bbappend \
"

BBFILE_COLLECTIONS += "jetson-customnux-dashboard"
BBFILE_PATTERN_jetson-customnux-dashboard = "^${LAYERDIR}/"
BBFILE_PRIORITY_jetson-customnux-dashboard = "13"
LAYERSERIES_COMPAT_jetson-customnux-dashboard = "scarthgap"
```

## meta-jetson-customnux-distro/conf/distro/default.conf
```bitbake
#@NAME: default
#@DESCRIPTION: default distro configuration
# bootloader: u-boot
# kernel: rpi-kernel
# init_manager: systemd
## journald: /var/log, persistence
# network_manager: netplan
# additional features: python3, jdk1.8, swupdate

######################################### DEFAULT SETTINGS #########################################
DISTRO = "default"
DISTRO_NAME = "default"
DISTRO_VERSION = "1.0"
DISTRO_CODENAME = "scarthgap"

SDK_VENDOR = "-customnuxsdk"
SDK_VERSION = "${@d.getVar('DISTRO_VERSION').replace('snapshot-${DATE}', 'snapshot')}"
SDK_NAME = "${DISTRO}-${TCLIBC}-${SDKMACHINE}-${IMAGE_BASENAME}-${TUNE_PKGARCH}-${MACHINE}"
SDKPATHINSTALL = "/opt/${DISTRO}/${SDK_VERSION}"
TARGET_VENDOR = "-customnux"

MAINTAINER = "Siho Kim <kim125y@naver.com>"

DISTRO_VERSION[vardepsexclude] = "DATE"
SDK_VERSION[vardepsexclude] = "DATE"
CUSTOM_DISTRO_FEATURES = " \
  largefile ptest multiarch swupdate usrmerge virtualization pam \
  opengl wayland vulkan\
  bluetooth \
"
DISTRO_EXTRA_RDEPENDS = " \
    systemd-custom-settings \
"
DISTRO_FEATURES = "${DISTRO_FEATURES_DEFAULT} ${CUSTOM_DISTRO_FEATURES}"

DISTRO_FEATURES:append = " systemd"
DISTRO_FEATURES:remove = "sysvinit"
VIRTUAL-RUNTIME_init_manager = "systemd"
VIRTUAL-RUNTIME_initscripts = "systemd-compat-units"
DISTRO_FEATURES_BACKFILL_CONSIDERED = "sysvinit"

DISTRO_FEATURES:remove = "x11"
LIBGLVND_PROVIDER = "libglvnd-tegra"

PACKAGECONFIG:remove:pn-qtbase = "opengl xcb"
PACKAGECONFIG:append:pn-qtbase = " gles2 egl eglfs kms gbm "
PACKAGECONFIG:append:pn-qtbase = " wayland-egl "

# network_manager
IMAGE_INSTALL:append = " netplan"

# QA check settings - a little stricter than the OE-Core defaults
WARN_TO_ERROR_QA = " \
    already-stripped compile-host-path install-host-path \
    installed-vs-shipped ldflags pn-overrides rpaths staticdev \
    unknown-configure-option useless-rpaths \
"
WARN_QA:remove = "${WARN_TO_ERROR_QA}"
ERROR_QA:append = " ${WARN_TO_ERROR_QA}"

require conf/distro/include/no-static-libs.inc
require conf/distro/include/yocto-uninative.inc
require conf/distro/include/security_flags.inc
INHERIT += "uninative"

# INHERIT += "reproducible_build"

BB_SIGNATURE_HANDLER ?= "OEEquivHash"
BB_HASHSERVE ??= "auto"

VOLATILE_LOG_DIR = "no"

########################################## PREFERRED SETTINGS #########################################
PREFERRED_VERSION_swupdate = "2024.12"

#PREFERRED_VERSION_libcamera = "0.4.0"

########################################## CUSTOM SETTINGS #########################################
# project user
IMAGE_INSTALL:append = " project-user"
DEFAULT_GROUP = "great"
DEFAULT_USER = "great"
```

## meta-jetson-customnux-distro/conf/layer.conf
```bitbake
BBPATH  =. "${LAYERDIR}:"
BBFILES += " \
    ${LAYERDIR}/recipes*/*/*.bb \
    ${LAYERDIR}/recipes*/*/*.bbappend \
"

BBFILE_COLLECTIONS += "jetson-customnux-distro"
BBFILE_PATTERN_jetson-customnux-distro = "^${LAYERDIR}/"
BBFILE_PRIORITY_jetson-customnux-distro = "14"
LAYERDEPENDS_jetson-customnux-distro = "core"
LAYERSERIES_COMPAT_jetson-customnux-distro = "scarthgap"
```
